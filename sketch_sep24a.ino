// generated by mBlock5 for mBot Ranger
// codes make you happy

#include <Arduino.h>
#include <Wire.h>
#include <SoftwareSerial.h>
#include <MeAuriga.h>
#include <cmath>


class Vector2D {
  public:
    const double x;
    const double y;
    const double v_norm;

    // Construct from x,y
    Vector2D(double x, double y)
        : x(x), y(y), v_norm(evaluate_vnorm(x, y)) {}

    // Construct from polar coords (radius, angle)
    Vector2D(double radius, double alpha, int)
        : x(std::cos(alpha) * radius),
          y(std::sin(alpha) * radius),
          v_norm(radius) {}

    double get_vnorm() const {
      return v_norm;
    }

    static double evaluate_vnorm(double x, double y) {
      return std::sqrt(std::pow(x, 2) + pow(y, 2));
    }

    Vector2D operator-(const Vector2D& vector) const {
      return Vector2D(x - vector.x, y - vector.y);
    }

    Vector2D operator+(const Vector2D& vector) const {
      return Vector2D(x + vector.x, y + vector.y);
    }
};


enum EntityState {
  SCAN,
  MOVE,
  SLEEP
};


class Entity {
  public:
    MeEncoderOnBoard encoder_1;
    MeEncoderOnBoard encoder_2;
    MeUltrasonicSensor ultra;

    EntityState internal_state;
    vector<pair<double, double>> internal_map; 
    
    Entity(uint16_t encoder_left_port, uint16_t encoder_right_port, uint16_t ultra_port)
      : encoder_1(encoder_left_port), encoder_2(encoder_right_port), ultra(ultra_port) {}

  private:
    void scan(int sample_measurement) {
      double grade = 360.0;
      double eps_increment = grade / sample_measurement;

      for (double angle = 0; angle < grade; angle += eps_increment) {
        // move of given angle
        
        // let sensor stabilize
        delay(100); 

        // take multiple readings for accuracy
        double distance = this->get_distance_mean(10);

        // save angle and distance
        internal_map.push_back({angle, distance});
      }
    }

    double get_distance_mean(int n_sample) {
      double mean_distance = 0.0;

      for (int i = 0; i < n_sample; ++i) {
        mean_distance += ultra.distanceCm();
      }

      return mean_distance / n_sample;
    }

    // Normalize angle into [0, 360)
    double mod_angle(double angle) {
      while (angle < 0) angle += 360.0;
      while (angle >= 360.0) angle -= 360.0;
      return angle;
    }
};


// ------------------------------ GENERATO DAL SITO -----------

void isr_process_encoder1(void)
{
  if(digitalRead(Encoder_1.getPortB()) == 0){
    Encoder_1.pulsePosMinus();
  }else{
    Encoder_1.pulsePosPlus();
  }
}
void isr_process_encoder2(void)
{
  if(digitalRead(Encoder_2.getPortB()) == 0){
    Encoder_2.pulsePosMinus();
  }else{
    Encoder_2.pulsePosPlus();
  }
}
void move(int direction, int speed)
{
  int leftSpeed = 0;
  int rightSpeed = 0;
  if(direction == 1){
    leftSpeed = -speed;
    rightSpeed = speed;
  }else if(direction == 2){
    leftSpeed = speed;
    rightSpeed = -speed;
  }else if(direction == 3){
    leftSpeed = -speed;
    rightSpeed = -speed;
  }else if(direction == 4){
    leftSpeed = speed;
    rightSpeed = speed;
  }
  Encoder_1.setTarPWM(leftSpeed);
  Encoder_2.setTarPWM(rightSpeed);
}

void _delay(float seconds) {
  if(seconds < 0.0){
    seconds = 0.0;
  }
  long endTime = millis() + seconds * 1000;
  while(millis() < endTime) _loop();
}

void setup() {
  randomSeed((unsigned long)(lightsensor_12.read() * 123456));
  TCCR1A = _BV(WGM10);
  TCCR1B = _BV(CS11) | _BV(WGM12);
  TCCR2A = _BV(WGM21) | _BV(WGM20);
  TCCR2B = _BV(CS21);
  attachInterrupt(Encoder_1.getIntNum(), isr_process_encoder1, RISING);
  attachInterrupt(Encoder_2.getIntNum(), isr_process_encoder2, RISING);

  Encoder_1.setTarPWM(-1 * 50/100.0*255);
  Encoder_2.setTarPWM(50/100.0*255);

}

void _loop() {
  Encoder_1.loop();
  Encoder_2.loop();
}

void loop() {
  _loop();
}